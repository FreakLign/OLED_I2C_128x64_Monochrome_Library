// ####################################################################################################################
// ##### PRINT STRING FROM PROGMEM ####################################################################################
// ####################################################################################################################
#include <mono_font_iso8859-1.h>
#include <Wire.h>
#include <avr/pgmspace.h>
#include <OLED_I2C_128x64_Monochrome.h>

// ####################################################################################################################
// ##### LANGUAGE #####################################################################################################
// ####################################################################################################################
/* Sorry about the umlaut displayed as the octal code from a CP437 code page (this is what they used in MSDOS) - 
 * will add proper UTF-8 support later 
 */
const byte LCD_Hyphen[] PROGMEM = "----------------";
const byte LCD_Text[] PROGMEM   = "V\224lker, h\224rt die";
const byte LCD_Text2[] PROGMEM   = "Signale!";
// ####################################################################################################################
// ##### SETUP ########################################################################################################
// ####################################################################################################################
void setup()
{
	// Initialize the display first!
	oled.initialize();
  oled.rotateDisplay180();
}
// ####################################################################################################################
// ##### LOOP #########################################################################################################
// ####################################################################################################################
void loop()
{
  oled.fontsize=1;
  oled.px = 0;
  oled.py = 0;
  for (int i=128;i<256;i++)
    oled.printChar(i);
  delay(2000);
  oled.clearDisplay();
  oled.setBrightness(255);
  // Simply call the function to print the string
  oled.setFontSize(1);
  writeText(LCD_Hyphen, 0, 0);
  oled.fontsize=1;
  writeText(LCD_Text,0,1);
  oled.setFontSize(2);
  writeText(LCD_Text2,   0, 2);

  oled.fontsize=3;
  oled.px=3;
  oled.py=5;
  oled.printNum(-99);	
  delay(500);
	// Dim the display down, displaying the actual brightness value
 
  for (int i=255;i>=0;i--)
  {
    oled.setBrightness(i);
    oled.px=3;
    oled.py=5;
    oled.printNum((char) i); 
  }
  delay(1500);  
}
// #################################################################################################################### 
// ######################################### WRITE STRING #############################################################
// ####################################################################################################################
void writeText(const byte Parameter_String[], byte Parameter_X, byte Parameter_Y)
{
	// SET PROGMEM BUFFER
	byte x05_Buffer;
	// PRINT CHAR FROM PROGMEM
	if (!Parameter_String)
	{
		return;
	}
  oled.px=Parameter_X;
  oled.py=Parameter_Y;
    while ((x05_Buffer = pgm_read_byte(Parameter_String++)))
    {
      	oled.printChar(x05_Buffer);
    }
}
// ####################################################################################################################
// ##### END OF CODE ##################################################################################################
// ####################################################################################################################
